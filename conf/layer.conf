## conf/layer.conf
```bitbake
# We have a conf and classes directory, add to BBPATH
BBPATH .= ":${LAYERDIR}"

# We have recipes-* directories, add to BBFILES
BBFILES += "${LAYERDIR}/recipes-*/*/*.bb \
            ${LAYERDIR}/recipes-*/*/*.bbappend"

BBFILE_COLLECTIONS += "resptech-elite"
BBFILE_PATTERN_resptech-elite = "^${LAYERDIR}/"
BBFILE_PRIORITY_resptech-elite = "6"

LAYERDEPENDS_resptech-elite = "core"
LAYERSERIES_COMPAT_resptech-elite = "dunfell"

IMAGE_INSTALL_append = " dropbear \
                         php \
                         php-cli \
                         php-fpm \
                         lighttpd \
                         lighttpd-module-access \
                         lighttpd-module-expire \
                         lighttpd-module-fastcgi \
                         jquery \
                         jquery-ui \
                         jquery-validation \
                         git \
                         sqlite3 \
                         libsqlite3-dev \
                         boost \
                         boost-dev \
                         rapidjson \
                         curl \
                         dnf \
"
```
